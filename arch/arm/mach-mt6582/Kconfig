## arch/arm/mach-mt6582/Kconfig
```kconfig
if ARCH_MT6582

menu "MT6582 Board Support Package"

choice
	bool "Board"

config MT6582_FPGA
	bool "MT6582 FPGA"
	select ARM_L1_CACHE_SHIFT_6
	help
	  Select if you are using the FPGA board.

config MT6582_EVB_BOARD
	bool "MT6582 EVB BOARD"
	select ARM_L1_CACHE_SHIFT_6
	help
	 Select if you are using an EVB board.

endchoice

config MT6582_FPGA_CA7
	tristate "MT6582 FPGA CA7" 
	depends on MT6582_FPGA
	default n
	help
	    Select if you are using the CA7 FPGA board.

config MAX_DRAM_SIZE_SUPPORT
	hex "The maximum size of the DRAM can be supported in the kernel"
	default 0x10000000
	depends on ARCH_MT6582
	help
		Define the maximum size of the kernel can be supported.
	        If will modify the memory size if it size is smaller than 
                the memory size passed by the boot loader to the MAX_DRAM_SIZE_SUPPORT.
   		Notice that the maximum DRAM size is including the memory size
	        reserved for the modem and the PMEM.

menu "MALATA MACRO DEFINE"

menu "MALATA PROJECT"
config MALATA_E1002
	bool "E1002 PROJECT"
	default n
	help
		select if you select e1002 project

config MALATA_F6901
        bool "F6901 PROJECT"
        default n
        help
                select if you select f6901 project

endmenu

menu "CUSTOMER PROJECT"

endmenu

menu "MALATA DEVICE DEFINE"

config MALATA_LCD_ID
	bool "LCD ID"
	default n
	help
		select if you need one more lcds

config MALATA_HW_VERSION
	bool "hw version"
	default n
	help
		select if you need different boards

config MALATA_MODEM_VERSION
	bool "modem version"
	default n
	help
		select if you need different modems
endmenu

endmenu

endmenu


endif
```
